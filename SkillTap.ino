
#include <Arduboy2.h>

Arduboy2 ard;
#define ARDBITMAP_SBUF ard.getBuffer()
#include <ArdBitmap.h>
ArdBitmap<WIDTH, HEIGHT> ardbitmap;

//128x64
const unsigned char PROGMEM SPLASH[] = {
	0x00, 0x00, 0x00, 0x00, 0x00, 0x00, 0x00, 0x00, 0x00, 0x00, 0x00, 0x80, 0xc0, 0x30, 0x10, 0x18,
	0x08, 0x08, 0x08, 0x08, 0x08, 0x08, 0x08, 0x08, 0x08, 0x18, 0x30, 0xe0, 0x00, 0x00, 0x00, 0x00,
	0x00, 0x00, 0x00, 0x00, 0x00, 0x00, 0x00, 0x00, 0x00, 0x00, 0x00, 0x00, 0x00, 0x00, 0x00, 0x00,
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	0x07, 0x05, 0x07, 0x00, 0x03, 0x03, 0x03, 0x03, 0x07, 0x06, 0x04, 0x04, 0x04, 0x04, 0x06, 0x07,
};
//128x64
const unsigned char PROGMEM FRAME[] = {
	0xff, 0x05, 0x07, 0x01, 0x01, 0x01, 0x01, 0x01, 0x01, 0x01, 0x01, 0x01, 0x01, 0x01, 0x01, 0x01,
	0x01, 0x01, 0x01, 0x01, 0x01, 0x01, 0x01, 0x01, 0x07, 0x05, 0xfd, 0x05, 0x07, 0x01, 0x01, 0x01,
	0x01, 0x01, 0x01, 0x01, 0x01, 0x01, 0x01, 0x01, 0x01, 0x01, 0x01, 0x01, 0x01, 0x01, 0x01, 0x01,
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	0xc0, 0xc0, 0xc0, 0xc0, 0xc0, 0xc0, 0xc0, 0xc0, 0xc0, 0xc0, 0xc0, 0xc0, 0xa0, 0x9f, 0xff, 0xff,
};
//20x3
const unsigned char PROGMEM BARS[] = {
	0x05, 0x05, 0x07, 0x02, 0x07, 0x05, 0x07, 0x02, 0x05, 0x07, 0x02, 0x07, 0x05, 0x02, 0x07, 0x05,
	0x07, 0x02, 0x07, 0x05, 0x05,
};
//24x8
const unsigned char PROGMEM EXPLOSION[] = {
	0x5d, 0x36, 0xa2, 0x63, 0x67, 0x75, 0x43, 0x62, 0x67, 0x2d, 0x2b, 0x42, 0x52, 0x71, 0x67, 0x21,
	0x25, 0x67, 0x52, 0x73, 0x66, 0xac, 0x3a, 0x40,
};
//8x8
const unsigned char PROGMEM TNTTRY[] = {
	0x04, 0x7c, 0x40, 0xf0, 0x18, 0x38, 0x18, 0xf0,
};

int y2, y3, y4, score, highScore, levelHighScore, speed, speed2, speed3, speed4, level, barOnScreen, levelSpeed;

const int BAR_X[] = { 3, 29, 55, 81 };
const int SHOW_FRAME = 5;
int showExpFrame[] = { SHOW_FRAME, SHOW_FRAME, SHOW_FRAME, SHOW_FRAME };
int showTryFrame[] = { SHOW_FRAME, SHOW_FRAME, SHOW_FRAME, SHOW_FRAME };

int barY[] = { 0, 0, 0, 0 };
bool bar[] = { false, false, false, false };
bool showExp[] = { false, false, false, false };
bool showTry[] = { false, false, false, false };
float combo;
bool pLeft, pDown, pUp, pA, pB, levelChange, newBar, increaseSpeed, SplashScreen;
const int STARTING_SCORE = 4;
//int lLine[] = { 1, 2, 3, 4, 5, 6, 7, 8, 9 };

void setup()
{
	ard.boot();
	ard.setFrameRate(20);
	barOnScreen = 0;

	speed = 1;
	level = 1;
	score = 0;
	combo = 0;
	highScore = score;
	levelHighScore = 0;
	levelSpeed = 1;
	SplashScreen = true;
	levelChange = true;
	pLeft = false;
	pDown = false;
	pA = false;
	pB = false;
	newBar = true;
	pUp = false;

}


void loop()
{

	if (!ard.nextFrame())
	{
		return;
	}
	
	ard.clear();
	ard.setRGBled(0, 0, 0);

	if (!levelChange)
	{
		DrawPlayingField();
		DrawElement();
		

		GameControl();

		PrintScore();
	}
	else
	{
		levelChange = DisplayLevel();
	}
	ard.display();

}

void MoveBar(int barChoice)
{
	//ard.drawFastHLine(BAR_X[barChoice], barY[barChoice], 20);
	ardbitmap.drawBitmap(BAR_X[barChoice], barY[barChoice] - 1, BARS, 20, 3, WHITE, ALIGN_H_LEFT, MIRROR_NONE);
	barY[barChoice] += speed;
}

void CheckBarStatus(int barChoice, bool buttonPressed)
{
	switch (buttonPressed)
	{
	case true:
		if (barY[barChoice] >= 53 && barY[barChoice] <= 63 && bar[barChoice])
		{
			//ardbitmap.drawBitmap(BAR_X[barChoice] - 1, 55, EXPLOSION, 24, 8, WHITE, ALIGN_H_LEFT, MIRROR_NONE);
			ard.setRGBled(0, 255, 0);
			ChangeScore(1);
			barY[barChoice] = 0;
			bar[barChoice] = false;
			newBar = true;
			barOnScreen--;
			showExp[barChoice] = true;

		}
		else
		{
			//ardbitmap.drawBitmap(BAR_X[barChoice] + 15, 55, TNTTRY, 8, 8, WHITE, ALIGN_H_LEFT, MIRROR_NONE);
			showTry[barChoice] = true;
		}
		break;
	case false:
		if (barY[barChoice] > 65 && bar[barChoice] && bar[barChoice])
		{
			ChangeScore(-1);
			ard.setRGBled(255, 0, 0);
			barY[barChoice] = 0;
			bar[barChoice] = false;
			newBar = true;
			barOnScreen--;
		}
		break;
	default:
		break;
	}

}


void GameControl()
{
	// LEFT Button
	if (ard.pressed(LEFT_BUTTON) && !pLeft)
	{
		CheckBarStatus(0, true);		
		pLeft = true;
	}
	
	if (ard.notPressed(LEFT_BUTTON))
	{
		pLeft = false;
	}

	// DOWN Button
	if (ard.pressed(DOWN_BUTTON) && !pDown)
	{
		CheckBarStatus(1, true);
		pDown = true;
	}

	if (ard.notPressed(DOWN_BUTTON))
	{
		pDown = false;
	}

	// A Button
	if (ard.pressed(A_BUTTON) && !pA)
	{
		CheckBarStatus(2, true);
		
		pA = true;
	}

	if (ard.notPressed(A_BUTTON))
	{
		pA = false;
	}

	// B Button
	if (ard.pressed(B_BUTTON) && !pB)
	{
		CheckBarStatus(3, true);
		
		pB = true;
	}

	if (ard.notPressed(B_BUTTON))
	{
		pB = false;
	}

	//Check if anybars when beyond the play field
	for (size_t i = 0; i < 4; i++)
	{
		CheckBarStatus(i, false); 
	}
	
	if (barOnScreen < 0)
	{
		barOnScreen = 0;
	}
}

void DrawElement() 
{
	int drawBar;

	switch (level % 4)
	{
	case 1:
		
		if (newBar)
		{
			if (barOnScreen < 1)
			{
				drawBar = rand() % 4;
				if (!bar[drawBar])
				{
					bar[drawBar] = true;
					barOnScreen++;
				}
				
			}
			newBar = false;
		}
		break;
	case 2:
		if (newBar)
		{
			for (size_t i = 0; i < 2; i++)
			{
				if (barOnScreen < 2)
				{
					drawBar = rand() % 4;
					if (!bar[drawBar])
					{
						bar[drawBar] = true;
						barOnScreen++;
					}
				}
			}
			newBar = false;
		}
		break;
	case 3:
		if (newBar)
		{
			for (size_t i = 0; i < 3; i++)
			{
				if (barOnScreen < 3)
				{
					drawBar = rand() % 4;
					if (!bar[drawBar])
					{
						bar[drawBar] = true;
						barOnScreen++;
					}
				}
			}
			newBar = false;
		}
		break;
	case 0:
		if (newBar)
		{
			for (size_t i = 0; i < 4; i++)
			{
				if (barOnScreen < 4)
				{
					drawBar = rand() % 4;
					if (!bar[drawBar])
					{
						bar[drawBar] = true;
						barOnScreen++;
					}
				}
			}
			newBar = false;
		}
		break;
	default:
		break;
	}

	//move Bar 1;
	if (bar[0])
	{
		MoveBar(0);
	}
	
	//move Bar 2
	if (bar[1])
	{
		MoveBar(1);
	}

	//move Bar 3
	if (bar[2])
	{
		MoveBar(2);
	}

	//move Bar 4
	if (bar[3])
	{
		MoveBar(3);
	}
}

void DrawPlayingField()
{
	

	ardbitmap.drawBitmap(0, 0, FRAME, 128, 64, WHITE,ALIGN_H_LEFT, MIRROR_NONE);

	for (size_t i = 0; i < 4; i++)
	{
		if (showExp[i] && showExpFrame[i] <= SHOW_FRAME)
		{
			ard.fillRect(BAR_X[i] - 1, 55, 24, 8, BLACK);
			ardbitmap.drawBitmap(BAR_X[i] - 1, 55, EXPLOSION, 24, 8, WHITE, ALIGN_H_LEFT, MIRROR_NONE);
			showExpFrame[i]--;
		}

		if (showTry[i] && showTryFrame[i] <= SHOW_FRAME)
		{
			ard.fillRect(BAR_X[i] + 15, 55, 8, 8, BLACK);
			ardbitmap.drawBitmap(BAR_X[i] + 15, 55, TNTTRY, 8, 8, WHITE, ALIGN_H_LEFT, MIRROR_NONE);
			showTryFrame[i]--;
		}
	}

	for (size_t i = 0; i < 4; i++)
	{
		if (showExpFrame[i] == 0)
		{
			showExp[i] = false;
			showExpFrame[i] = SHOW_FRAME;
		}

		if (showTryFrame[i] == 0)
		{
			showTry[i] = false;
			showTryFrame[i] = SHOW_FRAME;
		}
	}
}

void ChangeScore(int change)
{
	
	if (change > 0)
	{
		if (combo < 0)
		{
			combo = 0;
		}
		combo += change;
		score += float(change * (combo/2)) + 1;
	}
	else if (combo > 0)
	{
		combo = 0;
		combo += change;
	}

	if (highScore <= score)
	{
		highScore = score;
	}

	if (score < 0)
	{
		score = 0;
	}
	
}

void PrintScore()
{
	//Display Current Level
	ard.setCursor(107, 2);
	ard.print("LVL");
	ard.setCursor(110, 12);
	ard.print(level);

	//Display Current Score
	ard.setCursor(107, 24);
	ard.print("SCR");
	ard.setCursor(107, 34);
	ard.print(score);

	//Display Current Combo/Multiplier
	ard.setCursor(107, 44);
	ard.print("CMB");
	ard.setCursor(107, 54);
	ard.print(int(combo));

	/*ard.setCursor(106, 0);
	ard.print("HS");
	ard.setCursor(106, 8);
	ard.print(highScore);*/
	
	/*ard.setCursor(106, 45);
	ard.print(barOnScreen);*/
	if (score >= STARTING_SCORE * level)
	{
		levelChange = true;
		level++;
	}
}

bool DisplayLevel()
{
	String showLevel = "Level ";
	String showGoal = "Goal is: ";
	int goalInt = level * STARTING_SCORE;
	String goal;
	goal = goalInt;
	
	if (SplashScreen)
	{
		ard.clear();
		ardbitmap.drawBitmap(0, 0, SPLASH, 128, 64, WHITE, ALIGN_H_LEFT, MIRROR_NONE);
	}
	else
	{
		ard.setCursor(35, 20);
		if (level == 1)
		{
			ard.print("-SKILLTAP-");

		}
		else
		{
			ard.print(showLevel + level);
		}

		//Add speed +1 every 4 level
		if (level % 4 == 1 && level != 1)
		{
			if (increaseSpeed)
			{
				speed++;
				/*levelSpeed++;
				speed = levelSpeed;
				speed2 = levelSpeed;
				speed3 = levelSpeed;
				speed4 = levelSpeed;*/
				increaseSpeed = false;
			}

			ard.setCursor(20, 10);
			ard.print("SPEED INCREASED!");
		}
		ard.setCursor(35, 40);
		ard.print(showGoal + goal);

		ard.setCursor(18, 52);
		ard.print("UP to continue.");
	}
	
	
	

	if (ard.pressed(UP_BUTTON) && pUp)
	{
		pUp = false;
		if (SplashScreen)
		{
			SplashScreen = false;
		}
		else
		{
			score = 0;
			highScore = 0;
			combo = 0;
			increaseSpeed = true;
			for (size_t i = 0; i < 4; i++)
			{
				barY[i] = 0;
			}
			barOnScreen = 0;
			levelHighScore++;
			for (size_t i = 0; i < 4; i++)
			{
				bar[i] = false;
			}
			for (size_t i = 0; i < 4; i++)
			{
				showExp[i] = false;
				showTry[i] = false;
			}
			return false;
		}
		
	}
	if (ard.notPressed(UP_BUTTON))
	{
		pUp = true;
	}
	return true;
}
